/******************************************************************************
 ******************************************************************************
 **                                                                          **
 **                          ファイルヘッダー                                  **
 **                          File: hal_arduino.cpp                           **
 **                                                                          **
 ******************************************************************************
 ******************************************************************************/

/******************************************************************************
 *                                                                            *
 *                              ライブラリ読み込み                             *
 *                                                                            *
 ******************************************************************************/
#include "h_arduino.h"

#include <Arduino.h>

#include "../../constants/constant.h"

/******************************************************************************
 *                                                                            *
 *                              ピンモード設定関数                             *
 *                                                                            *
 ******************************************************************************/
global_err_t halPinMode(int pin, hal_pin_mode_t mode) {
  /*----------------------------------------------------------------------------*
   *                          ArduinoのpinMode呼び出し                          *
   *----------------------------------------------------------------------------*/
  switch (mode) {
    case HAL_PIN_MODE_INPUT:
      pinMode(pin, INPUT);
      break;
    case HAL_PIN_MODE_OUTPUT:
      pinMode(pin, OUTPUT);
      break;
    case HAL_PIN_MODE_INPUT_PULLUP:
      pinMode(pin, INPUT_PULLUP);
      break;
    default:
      return GLOBAL_ERR_INVALID_PARAM;
  }
  return GLOBAL_OK;
}

/******************************************************************************
 *                                                                            *
 *                              デジタル書き込み関数                           *
 *                                                                            *
 ******************************************************************************/
global_err_t halDigitalWrite(int pin, bool value) {
  /*----------------------------------------------------------------------------*
   *                          ArduinoのdigitalWrite呼び出し                     *
   *----------------------------------------------------------------------------*/
  digitalWrite(pin, value ? HIGH : LOW);
  return GLOBAL_OK;
}

/******************************************************************************
 *                                                                            *
 *                              デジタル読み込み関数                           *
 *                                                                            *
 ******************************************************************************/
global_err_t halDigitalRead(int pin, bool* out) {
  /*----------------------------------------------------------------------------*
   *                          NULLチェック                                      *
   *----------------------------------------------------------------------------*/
  if (out == nullptr) {
    return GLOBAL_ERR_INVALID_PARAM;
  }

  /*----------------------------------------------------------------------------*
   *                          ArduinoのdigitalRead呼び出し                      *
   *----------------------------------------------------------------------------*/
  int val = digitalRead(pin);
  *out = (val == HIGH);
  return GLOBAL_OK;
}

/******************************************************************************
 *                                                                            *
 *                              ミリ秒取得関数                                 *
 *                                                                            *
 ******************************************************************************/
global_err_t halMillis(unsigned long* out) {
  /*----------------------------------------------------------------------------*
   *                          NULLチェック                                      *
   *----------------------------------------------------------------------------*/
  if (out == nullptr) {
    return GLOBAL_ERR_INVALID_PARAM;
  }

  /*----------------------------------------------------------------------------*
   *                          Arduinoのmillis呼び出し                           *
   *----------------------------------------------------------------------------*/
  *out = millis();
  return GLOBAL_OK;
}

/******************************************************************************
 *                                                                            *
 *                              シリアル通信開始関数                           *
 *                                                                            *
 ******************************************************************************/
global_err_t halSerialBegin(unsigned long baud) {
  /*----------------------------------------------------------------------------*
   *                          シリアル通信開始                                  *
   *----------------------------------------------------------------------------*/
  Serial.begin(baud);
  return GLOBAL_OK;
}

/******************************************************************************
 *                                                                            *
 *                              シリアル通信入力チェック関数                   *
 *                                                                            *
 ******************************************************************************/
global_err_t halSerialAvailable(bool* out) {
  /*----------------------------------------------------------------------------*
   *                          NULLチェック                                      *
   *----------------------------------------------------------------------------*/
  if (out == nullptr) {
    return GLOBAL_ERR_INVALID_PARAM;
  }

  /*----------------------------------------------------------------------------*
   *                          シリアル通信入力チェック                          *
   *----------------------------------------------------------------------------*/
  *out = (Serial.available() > 0);
  return GLOBAL_OK;
}

/******************************************************************************
 *                                                                            *
 *                              シリアル通信1バイト受信関数                   *
 *                                                                            *
 ******************************************************************************/
global_err_t halSerialRead(char* out) {
  /*----------------------------------------------------------------------------*
   *                          NULLチェック                                      *
   *----------------------------------------------------------------------------*/
  if (out == nullptr) {
    return GLOBAL_ERR_INVALID_PARAM;
  }

  /*----------------------------------------------------------------------------*
   *                          シリアル通信1バイト受信                           *
   *----------------------------------------------------------------------------*/
  *out = Serial.read();
  return GLOBAL_OK;
}

/******************************************************************************
 *                                                                            *
 *                              シリアル通信フラッシュ関数                     *
 *                                                                            *
 ******************************************************************************/
global_err_t halSerialFlush(void) {
  /*----------------------------------------------------------------------------*
   *                          シリアル通信フラッシュ                            *
   *----------------------------------------------------------------------------*/
  Serial.flush();
  return GLOBAL_OK;
}